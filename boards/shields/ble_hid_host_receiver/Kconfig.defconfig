## boards/shields/ble_hid_host_receiver/Kconfig.defconfig
```kconfig
# Copyright (c) 2026 akira-toriyama
# SPDX-License-Identifier: MIT

if SHIELD_BLE_HID_HOST_RECEIVER

config ZMK_KEYBOARD_NAME
    default "BLE HID Host"

endif
```

## boards/shields/ble_hid_host_receiver/Kconfig.shield
```kconfig
# Copyright (c) 2026 akira-toriyama
# SPDX-License-Identifier: MIT

config SHIELD_BLE_HID_HOST_RECEIVER
    def_bool $(shields_list_contains,ble_hid_host_receiver)
```

## config/west.yml
```yaml
# West manifest for building this module's firmware in CI.
#
# This repo plays TWO roles in a ZMK firmware build (see HANDOFF.md §M2/§4):
#   1. zmk-config  -- this config/ directory (consumed via `west init -l config`)
#   2. Zephyr module -- the repo root (auto-injected via -DZMK_EXTRA_MODULES
#      because zephyr/module.yml exists; the reusable workflow detects it).
#
# So we only need to import zmk here; the module itself does not need a project
# entry. Do NOT copy probe/west.yml -- that is a raw-Zephyr "app=manifest"
# layout with a name-blocklist and would pull bare Zephyr instead of zmk/app.
manifest:
  remotes:
    - name: zmkfirmware
      url-base: https://github.com/zmkfirmware
  projects:
    - name: zmk
      remote: zmkfirmware
      revision: main
      import: app/west.yml
  self:
    path: config
```

## drivers/Kconfig
```kconfig
# Copyright (c) 2026 akira-toriyama
# SPDX-License-Identifier: MIT

rsource "input/Kconfig"
```

## drivers/input/Kconfig
```kconfig
# Copyright (c) 2026 akira-toriyama
# SPDX-License-Identifier: MIT

if INPUT

menuconfig ZMK_BLE_HID_HOST
    bool "ZMK BLE HID Host (HOGP central) input device"
    default y
    depends on DT_HAS_ZMK_BLE_HID_HOST_ENABLED
    help
      Connect to a Bluetooth HID (HOGP / HID-over-GATT) pointing device as a
      BLE central, decode its HID reports, and republish them into ZMK's input
      subsystem so they can be remapped by zmk,input-listener / input-processors
      and output over USB/BLE by ZMK core.

      This module performs ingest only. Remapping and HID output stay in ZMK.

      Enabled automatically when a "zmk,ble-hid-host" devicetree node is present.

if ZMK_BLE_HID_HOST

# Standard Zephyr logging level knob -> CONFIG_ZMK_BLE_HID_HOST_LOG_LEVEL.
module = ZMK_BLE_HID_HOST
module-str = ZMK BLE HID Host
source "subsys/logging/Kconfig.template.log_config"

# Wheel-axis -> key taps. The wheel is a signed axis (left/right and up/down
# share one code, differing only by sign), which ZMK's stock code-only
# input-processors cannot split. When enabled, this module converts each tick
# into a tap of a distinct DPAD code so it can be remapped to a key/layer via
# zmk,input-processor-behaviors. Default n keeps the module a generic scroll
# source; the two axes are independent so you can key one and scroll the other.

config ZMK_BLE_HID_HOST_HWHEEL_AS_KEYS
    bool "Emit horizontal wheel (tilt) as DPAD_LEFT/RIGHT key taps"
    default n
    help
      Convert each horizontal-wheel tick into a tap of INPUT_BTN_DPAD_LEFT
      (tilt left) / INPUT_BTN_DPAD_RIGHT (tilt right) instead of an
      INPUT_REL_HWHEEL scroll event. Repurposes the axis: horizontal scroll is
      no longer emitted while enabled.

config ZMK_BLE_HID_HOST_WHEEL_AS_KEYS
    bool "Emit vertical wheel as DPAD_UP/DOWN key taps"
    default n
    help
      Convert each vertical-wheel tick into a tap of INPUT_BTN_DPAD_UP (up) /
      INPUT_BTN_DPAD_DOWN (down) instead of an INPUT_REL_WHEEL scroll event.
      Repurposes the axis: vertical scroll is no longer emitted while enabled.

# NOTE (M1): the BLE central / GATT-client requirements are NOT selected here
# yet. They are documented in README.md and must be enabled in the consuming
# zmk-config (CONFIG_BT_CENTRAL, CONFIG_BT_OBSERVER, CONFIG_BT_GATT_CLIENT,
# CONFIG_BT_GATT_AUTO_DISCOVER_CCC, a sufficient CONFIG_BT_MAX_CONN, etc.).
# Milestone M1 will revisit whether to `select` the additive ones here.

endif # ZMK_BLE_HID_HOST

endif # INPUT
```

## dts/bindings/input/zmk,ble-hid-host.yaml
```yaml
# Copyright (c) 2026 akira-toriyama
# SPDX-License-Identifier: MIT

description: |
  Virtual input device that connects to a Bluetooth HID (HOGP) pointing device
  as a BLE central, decodes its HID reports, and republishes them into ZMK's
  input subsystem. Bind it with a zmk,input-listener node.

  The byte layout of the peer's reports is derived at runtime from its HID
  Report Map (characteristic 0x2A4B), so no field offsets are configured here.

compatible: "zmk,ble-hid-host"

properties:
  device-name:
    type: string
    description: |
      Optional. If set, only connect to a peer whose GAP advertised name
      matches this string exactly. If unset, connect to the first discovered
      HOGP pointing device (Appearance / HID service based).
```
